## Kconfig.defconfig
```kconfig
# Copyright (c) 2020 The ZMK Contributors
# SPDX-License-Identifier: MIT


if SHIELD_KAMAO_LEFT

config ZMK_KEYBOARD_NAME
	default "XJAM32-LEFT"

config ZMK_SPLIT_BLE_ROLE_CENTRAL
	default y

endif

if SHIELD_KAMAO_RIGHT || SHIELD_KAMAO_LEFT 

config ZMK_SPLIT
	default y

endif
```

## zmk/Kconfig.shield
```kconfig
# Copyright (c) 2020 The ZMK Contributors
# SPDX-License-Identifier: MIT

config SHIELD_KAMAO_LEFT
	def_bool $(shields_list_contains,kamao_left)

config SHIELD_KAMAO_RIGHT
	def_bool $(shields_list_contains,kamao_right)
```
